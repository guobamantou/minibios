## Kconfig
```kconfig
mainmenu "minibios configuration"

menu "CPU selection"
choice 
	prompt "CPU type"
	default LOONGSON2F
config LOONGSON2F 
	bool "Loongson 2F"
config LOONGSON2G
	bool "Loongson 2G"
endchoice
endmenu

menu "cpu function selection"
config ENABLE_CACHE
	bool "enable cache"
	help
		enable cache in minibios	
endmenu

menu "Board selection"
config LOONGSON2F_FULOONG
	bool "Loongson2F fuloong"
	depends on LOONGSON2F
	help
		include fuloong 600x and 601x series
config LOONGSON2F_YEELOONG
	bool "Loongson2F yeeloong"
	depends on LOONGSON2F
	help
		include yeloong 8089 and 8010 
config LOONGSON2G_DEVBOARD
	bool "Loongson2G dev board"
	depends on LOONGSON2G
endmenu

menu "minibios type"
choice 
	prompt "code model"
	default 3BITS
config 32BITS 
	bool "32-bits"
config 64BITS 
	bool "64-bits"
endchoice
config DYMATIC_CPUFREQ
	bool "dymatic cpu freq detect"
config STATIC_CPUFREQ
	int "static cpu freq"
	depends on !DYMATIC_CPUFREQ 
	default 800000000 if LOONGSON2F
	default 660000000 if LOONGSON2E
	default 900000000 if LOONGSON2G
config DEBUG
	bool "DEBUG"

endmenu


menu "Device"
menu "Flash"
config SST 
	bool "SST"
config MACRONIX
	bool "MACRONIX"
endmenu
endmenu
```

## drivers/Kconfig
```kconfig
menu  "UART select"
chioce	
	prompt "UART select"
config Loongson2F-UART1
	bool "Loongson2F UART 1"
	depends on Loongson2F
config Loongson2F-UART2
	bool "Loongson2F UART 2"
	depends on Loongson2F
config Loongson2G-UART1
	bool "Loongson2G UART 1"
	depends on Loongson2G
endchoice
endmenu
```
